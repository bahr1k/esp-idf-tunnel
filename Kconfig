## Kconfig
```kconfig
menu "Web Tunnel"

    config WEB_TUNNEL_URI
        string "Web tunnels provider address"
        default "wss://device-tunnel.top:3333"
        help
            "Main server that provides tunnels"

    config WEB_TUNNEL_DOMAIN
        string "Domain"
        default ""
        help
            "Your account's public domain for remote device connections"

    config WEB_TUNNEL_SECRET
        string "Account secret"
        default ""
        help
            "Your account's secret key for remote devices"

endmenu
```
